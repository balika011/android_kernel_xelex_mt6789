#include "qx0_charger.dtsi"

&accdet {
	/* eint_level_trigger: 8,LEVEL_LOW(DEF) ;4,LV_HIGH;others,LV_LOW */
	headset-eint-level-pol = <8>;
};

&pe5 {
	tta_curlmt = <0 0 0 0 0 300 600 900 (-1)>;
	tbat_curlmt = <(-1) (-1) (-1) 300 0 600 900 1050 (-1)>;
	tdvchg_curlmt = <(-1) (-1) (-1) 300 0 300 600 900 (-1)>;
	tswchg_curlmt = <(-1) (-1) (-1) 200 0 200 300 400 (-1)>;
};