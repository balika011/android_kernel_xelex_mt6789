// SPDX-License-Identifier: (GPL-2.0 OR MIT)
/*
 * Copyright (C) 2021 MediaTek Inc.
 */
/dts-v1/;
/plugin/;
#include <dt-bindings/interrupt-controller/arm-gic.h>
#include <dt-bindings/interrupt-controller/irq.h>
#include <dt-bindings/pinctrl/mt6789-pinfunc.h>
#include <dt-bindings/usb/pd.h>
#include <dt-bindings/phy/phy.h>
#include <dt-bindings/iio/mt635x-auxadc.h>

#include "q20_audio.dtsi"
#include "q20_camera.dtsi"
#include "q20_charger.dtsi"
#include "q20_display.dtsi"
#include "qx0_gps.dtsi"
#include "q20_keyboard.dtsi"
#include "qx0_nfc.dtsi"

#include "q20_v12_factory/cust.dtsi"
/*End of this file, DO NOT ADD ANYTHING HERE*/
