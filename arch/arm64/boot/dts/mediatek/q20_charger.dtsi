#include "qx0_charger.dtsi"

&accdet {
	/* eint_level_trigger: 8,LEVEL_LOW(DEF) ;4,LV_HIGH;others,LV_LOW */
	headset-eint-level-pol = <4>;
};

&pe5 {
	tta_curlmt = <0 0 0 0 0 0 0 0 (-1)>;
	tbat_curlmt = <(-1) (-1) (-1) (-1) (-1) (-1) (-1) (-1) (-1)>;
	tdvchg_curlmt = <(-1) (-1) (-1) (-1) (-1) (-1) (-1) (-1) (-1)>;
	tswchg_curlmt = <(-1) (-1) (-1) (-1) (-1) (-1) (-1) (-1) (-1)>;
};